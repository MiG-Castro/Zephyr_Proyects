## IMU_Node_vMailbox00/build/Kconfig/Kconfig.shield.defconfig
```kconfig
osource "c:/ncs/proyectos/personales/a_repositorio_nodoimu/imu_node_vmailbox00/boards/shields/*/Kconfig.defconfig"
osource "C:/ncs/v3.0.1/nrf/boards/shields/*/Kconfig.defconfig"
```

## IMU_Node_vMailbox01/build/Kconfig/Kconfig.shield
```kconfig
osource "c:/ncs/proyectos/personales/a_repositorio_nodoimu/imu_node_vmailbox01/boards/shields/*/Kconfig.shield"
osource "C:/ncs/v3.0.1/nrf/boards/shields/*/Kconfig.shield"
```

## IMU_Node_vMailbox01/build/Kconfig/boards/Kconfig
```kconfig
# Load Zephyr board Kconfig descriptions.
osource "C:/ncs/v3.0.1/zephyr/boards/seeed/xiao_ble/Kconfig"
```

## Perfil_IMU_Periferico/build/Kconfig/Kconfig.shield
```kconfig
osource "c:/ncs/proyectos/personales/a_repositorio_nodoimu/perfil_imu_periferico/boards/shields/*/Kconfig.shield"
osource "C:/ncs/v3.0.1/nrf/boards/shields/*/Kconfig.shield"
```
